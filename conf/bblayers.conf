## conf/bblayers.conf
```bitbake
# LAYER_CONF_VERSION is increased each time build/conf/bblayers.conf
# changes incompatibly
LCONF_VERSION = "6"

BBPATH = "${TOPDIR}"
BBFILES ?= ""

BBLAYERS ?= " \
  ${TOPDIR}/../meta \
  ${TOPDIR}/../meta-yocto \
  ${TOPDIR}/../meta-yocto-bsp \
  ${TOPDIR}/../../openembedded-core/meta \
  ${TOPDIR}/../../meta-openembedded/meta-multimedia \
  ${TOPDIR}/../../meta-openembedded/meta-networking \
  ${TOPDIR}/../../meta-openembedded/meta-oe \
  ${TOPDIR}/../../meta-openembedded/meta-python \
  ${TOPDIR}/../../meta-qt5 \
  ${TOPDIR}/../../meta-raspberrypi \
  ${TOPDIR}/../../meta-shadowhunt \
  "
BBLAYERS_NON_REMOVABLE ?= " \
  ${TOPDIR}/../meta \
  ${TOPDIR}/../meta-yocto \
  "
```

## meta-shadowhunt/conf/distro/shadowhunt.conf
```bitbake
require conf/distro/poky.conf

DISTRO = "shadowhunt"
DISTRO_NAME = "shadowhunt system"

DISTRO_FEATURES_remove = " wayland "
```

## meta-shadowhunt/conf/layer.conf
```bitbake
# We have a conf and classes directory, append to BBPATH
BBPATH .= ":${LAYERDIR}"

# We have a recipes directory containing .bb and .bbappend files, add to BBFILES
BBFILES += "${LAYERDIR}/recipes-*/*/*.bb \
            ${LAYERDIR}/recipes-*/*/*.bbappend"

BBFILE_COLLECTIONS += "shadowhunt"
BBFILE_PATTERN_shadowhunt := "^${LAYERDIR}/"
BBFILE_PRIORITY_shadowhunt = "15"
```
